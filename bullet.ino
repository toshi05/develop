
#include <PixelPlus.h>


#define MAX_DISP_X 127//画面サイズ
#define MAX_DISP_Y 127//画面サイズ


PixelPlus PIXEL ;
void DrawImage(int id,int x,int y,int flag);

typedef struct{
  int id;
  int x;
  int y;
  int flag;
}
bull_info;
bull_info bullet[5] = {
  {
    0,60,60,0  }
  ,{
    1,60,60,0  }
  ,{
    2,60,60,0  }
  ,{
    3,60,60,0  }
  ,{
    4,60,60,0  }
};


// ボールのデータ（縁取りが白いボール）
PROGMEM uint16_t white[] = {
  0xFFFE,0xFFFE,0xFFFE,0xFFFE,0xFFFE,0xFFFE,0xFFFE,0xFFFE,0xFFFE,0xFFFE,
  0xFFFE,0xFFFE,0xFFFE,0xFFFE,0xFFFE,0xFFFE,0xFFFE,0xFFFE,0xFFFE,0xFFFE,
  0xFFFE,0xFFFE,0xFFFE,0xFFFE,0xFFFE,0xFFFE,0xFFFE,0xFFFE,0xFFFE,0xFFFE,
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  0xFFFE,0xFFFE,0xFFFE,0xFFFE,0xFFFE,0xFFFE,0xFFFE,0xFFFE,0xFFFE,0xFFFE,
};

PROGMEM uint16_t ball[] = {
  0xFFFE,0xFFFE,0xFFFE,0xFFFE,0xFFFE,0xFFFE,0xFFFE,0xFFFE,0xFFFE,0xFFFE,
  0xFFFE,0xFFFE,0xFFFE,0xFFFE,0xFFFE,0xFFFE,0xFFFE,0xFFFE,0xFFFE,0xFFFE,
  0xFFFE,0xFFFE,0xFFFE,0xFB79,0xFB79,0xFB79,0xFB79,0xFFFE,0xFFFE,0xFFFE,
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  0xFFFE,0xFFFE,0xFFFE,0xFFFE,0xFFFE,0xFFFE,0xFFFE,0xFFFE,0xFFFE,0xFFFE,
};

PROGMEM uint16_t player[] = {
  0xFFFE,0xFFFE,0xFFFE,0xFFFE,0xFFFE,0xFFFE,0xFFFE,0xFFFE,0xFFFE,0xFFFE,
  0xFFFE,0xFFFE,0xFFFE,0xFFFE,0xFFFE,0xFFFE,0xFFFE,0xFFFE,0xFFFE,0xFFFE,
  0xFFFE,0xFFFE,0x0000,0x0000,0x0000,0x0000,0x0000,0x0000,0xFFFE,0xFFFE,
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  0xFFFE,0xFFFE,0xFFFE,0xFFFE,0xFFFE,0xFFFE,0xFFFE,0xFFFE,0xFFFE,0xFFFE,
};
int x_pos = 0;
int y_pos = -1;
int count = 0;

void setup(){
  Serial.begin(9600);   
  PIXEL.init() ;
  PIXEL.backLight(1) ;
  PIXEL.clear(255, 255, 255);
  PIXEL.createSprite(12,10,10);//白塗りつぶし
  PIXEL.fillSprite(12,white);//
  PIXEL.createSprite(11,10,10);//黒四角
  PIXEL.fillSprite(11,player);//黒四角
  PIXEL.createSprite(0, 10,10);//ボール
  PIXEL.fillSprite(0, ball);
}

void loop(){
  if(PIXEL.sw1()){
    
    bullet[count].flag = 1;
    Serial.print(count);
    Serial.print('\n');
    Serial.print(bullet[count].flag);
    Serial.print('\n');
    count++;
    }
    if(count == 4) count = 0;
  for(int i = 0;i < 5; i++){
    if(bullet[i].y == 1) {
      bullet[i].flag = 0;
    }
    if(bullet[i].flag == 1){
      switch(i){
      case 0 :
        DrawImage(i,bullet[i].x,bullet[i].y,bullet[i].flag);
        delay(1);
        bullet[i].y = bullet[i].y -1;
        Serial.print(i);
        break;
      case 1 :
        DrawImage(i,bullet[i].x,bullet[i].y,bullet[i].flag);
        bullet[i].y = bullet[i].y -1;
        Serial.print('B');
        delay(10);
        break;
      case 2 :
        DrawImage(i,bullet[i].x,bullet[i].y,bullet[i].flag);
        bullet[i].y = bullet[i].y -1;
        Serial.print('C');
        break;
        delay(100);
      case 3 :
        DrawImage(i,bullet[i].x,bullet[i].y,bullet[i].flag);
        bullet[i].y = bullet[i].y -1;
        break;
      case 4 :
        DrawImage(i,bullet[i].x,bullet[i].y,bullet[i].flag);
        bullet[i].y = bullet[i].y -1;
        break;
      default :
        break;
      }
    }else{
      DrawImage(12,bullet[i].x,bullet[i].y,bullet[i].flag);
      bullet[i].y = 60; 
    }
  }
}
void DrawImage(int id,int x,int y,int flag){
  if(flag == 0) PIXEL.drawSprite(12,x,y);
  else PIXEL.drawSprite(id,x,y);
}

